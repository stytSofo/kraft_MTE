SECTIONS
{
	.data_comp{{ comp_nr }} : {
		* (.data .data.* .rodata .rodata.*)
	}
}
INSERT AFTER .text;

SECTIONS
{
	.bss_comp{{ comp_nr }} : {
		* (.bss .bss.* COMMON)
	}
}
INSERT AFTER .data;

SECTIONS
{
	.initarray_comp{{ comp_nr }} : {
		* (.initarray .initarray.*)
	}
}

/* discard rules would come here */
